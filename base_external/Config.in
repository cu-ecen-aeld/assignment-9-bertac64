## base_external/Config.in
```kconfig
source "/home/berta/Documenti/assignment-4-bertac64/base_external/package/aesd-assignments/Config.in"
```

## base_external/package/ldd/Config.in
```kconfig
config BR2_PACKAGE_LDD
	bool "ldd"
	help
	  Includes the assignments 7 files in the kernel image.
	  Used to understand buildroot external trees and package builds.
```
